## ble-examples/bleprph_wifi_coex/main/Kconfig.projbuild
```kconfig
menu "Example Configuration"

    config EXAMPLE_ESP_WIFI_SSID
        string "WiFi SSID"
        default "myssid"
        help
            SSID (network name) for the example to connect to.

    config EXAMPLE_ESP_WIFI_PASSWORD
        string "WiFi Password"
        default "mypassword"
        help
            WiFi password (WPA or WPA2) for the example to use.

    config EXAMPLE_ESP_MAXIMUM_RETRY
        int "WIFI Connect Maximum retry"
        default 5
        help
            Set the Maximum retry to avoid station reconnecting to the AP unlimited when the AP is really inexistent.

endmenu
```
